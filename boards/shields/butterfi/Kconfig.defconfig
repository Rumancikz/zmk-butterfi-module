## boards/shields/butterfi/Kconfig.defconfig
```kconfig
if SHIELD_BUTTERFI_LEFT

# Name must be less than 16 characters long!
config ZMK_KEYBOARD_NAME
    default "butterfi"

config ZMK_SPLIT_ROLE_CENTRAL
    default y

endif

if SHIELD_BUTTERFI_LEFT || SHIELD_BUTTERFI_RIGHT

config ZMK_SPLIT
    default y

endif
```

## boards/shields/butterfi/Kconfig.shield
```kconfig
config SHIELD_BUTTERFI_LEFT
    def_bool $(shields_list_contains,butterfi_left)

config SHIELD_BUTTERFI_RIGHT
    def_bool $(shields_list_contains,butterfi_right)

config SHIELD_NICE_VIEW_CCC
    def_bool $(shields_list_contains,nice_view_ccc)
```
